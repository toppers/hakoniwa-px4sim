## px4/hakoniwa-apps/px4_csv_logger/Kconfig
```kconfig
menuconfig EXAMPLES_PX4_CSV_LOGGER
	bool "px4_csv_logger"
	default y
	---help---
		Enable support for px4_csv_logger
```

## px4/hakoniwa-apps/px4_hakoniwa/Kconfig
```kconfig
menuconfig EXAMPLES_PX4_HAKONIWA
	bool "px4_hakoniwa"
	default y
	---help---
		Enable support for px4_hakoniwa
```
